## CMakeLists.txt
```
# Copyright (c) 2026 Muhammad Waleed Badar
# SPDX-License-Identifier: GPL-3.0-only

cmake_minimum_required(VERSION 3.20.0)

find_package(Zephyr REQUIRED HINTS $ENV{ZEPHYR_BASE})
project(zspot_base62_test)

set(ZSPOT_ROOT ${CMAKE_CURRENT_SOURCE_DIR}/../../..)

# The helpers of the protocol core, which need nothing of the library around them
target_sources(app PRIVATE src/main.cpp ${ZSPOT_ROOT}/lib/zspot/src/core/Utils.cpp)
target_include_directories(app PRIVATE ${ZSPOT_ROOT}/lib/zspot/src)
```

## prj.conf
```kconfig
# Copyright (c) 2026 Muhammad Waleed Badar
# SPDX-License-Identifier: GPL-3.0-only

CONFIG_ZTEST=y

# The protocol core is C++ with the standard library and exceptions
CONFIG_CPP=y
CONFIG_STD_CPP20=y
CONFIG_REQUIRES_FULL_LIBCPP=y
CONFIG_CPP_EXCEPTIONS=y

# Utils.cpp swaps byte order with the network stack's helpers
CONFIG_NETWORKING=y
CONFIG_NET_LOOPBACK=y
```

## src/main.c
```c
/*
 * Copyright (c) 2026 Muhammad Waleed Badar
 *
 * SPDX-License-Identifier: GPL-3.0-only
 */

#include <string.h>

#include <zephyr/ztest.h>

#include "port/base62.h"

/* Encodes the 16 bytes of an id; the byte behind the result must stay as it is. */
static const char *encode_id(const uint8_t *id)
{
	static char out[ZSPOT_BASE62_ID_DIGITS + 2];

	memset(out, '#', sizeof(out));
	zspot_base62_encode(id, 16, out, ZSPOT_BASE62_ID_DIGITS);
	zassert_equal(out[ZSPOT_BASE62_ID_DIGITS], '\0');
	zassert_equal(out[ZSPOT_BASE62_ID_DIGITS + 1], '#');
	return out;
}

ZTEST(zspot_base62, test_smallest_and_largest_id)
{
	uint8_t id[16] = {0};

	zassert_str_equal(encode_id(id), "0000000000000000000000");
	id[15] = 1;
	zassert_str_equal(encode_id(id), "0000000000000000000001");
	memset(id, 0xff, sizeof(id));
	zassert_str_equal(encode_id(id), "7N42dgm5tFLK9N8MT7fHC7");
}

/* The alphabet runs from the digits over the lower-case to the upper-case letters. */
ZTEST(zspot_base62, test_ids)
{
	static const uint8_t count[16] = {0x00, 0x01, 0x02, 0x03, 0x04, 0x05, 0x06, 0x07,
					  0x08, 0x09, 0x0a, 0x0b, 0x0c, 0x0d, 0x0e, 0x0f};
	static const uint8_t mixed[16] = {0x5b, 0x6d, 0x0a, 0x3f, 0x9c, 0x2e, 0x4d, 0x17,
					  0xa8, 0xb0, 0xc4, 0xe1, 0xf2, 0x93, 0x74, 0x65};
	/* What the library reads spotify:track:4uLU6hMCjMI75M1A2tKUQC as */
	static const uint8_t track[16] = {0x93, 0xbc, 0x41, 0x4a, 0x60, 0x67, 0x47, 0xb2,
					  0xb6, 0x12, 0x49, 0x1e, 0xf8, 0x3d, 0x5a, 0x3e};

	zassert_str_equal(encode_id(count), "000syw7rIjXKeGogUSqgWP");
	zassert_str_equal(encode_id(mixed), "2Mw8fYX4YKmcMOc8sumlKZ");
	zassert_str_equal(encode_id(track), "4uLU6hMCjMI75M1A2tKUQC");
}

ZTEST(zspot_base62, test_other_lengths)
{
	static const uint8_t two[] = {0x01, 0x00};
	static const uint8_t wide[] = {0x0e, 0xff};
	uint8_t longer[40] = {0};
	char out[8];

	zspot_base62_encode(two, sizeof(two), out, 4);
	zassert_str_equal(out, "0048");

	/* 3839 is "ZV" in two digits, which is all that is asked for */
	zspot_base62_encode(wide, sizeof(wide), out, 2);
	zassert_str_equal(out, "ZV");

	/* More bytes than an id has: the lower ones count */
	longer[39] = 62;
	zspot_base62_encode(longer, sizeof(longer), out, 3);
	zassert_str_equal(out, "010");

	zspot_base62_encode(two, 0, out, 2);
	zassert_str_equal(out, "00");
}

ZTEST_SUITE(zspot_base62, NULL, NULL, NULL, NULL, NULL);
```

## src/main.cpp
```c
/*
 * Copyright (c) 2026 Muhammad Waleed Badar
 *
 * SPDX-License-Identifier: GPL-3.0-only
 */

#include <cstdint>
#include <string>
#include <vector>

#include <zephyr/ztest.h>

#include "core/Utils.h"

/* The 22 digits of the 16 bytes of an id */
static std::string encode_id(const std::vector<uint8_t> &id)
{
	return base62Encode(id, 22);
}

ZTEST(zspot_base62, test_smallest_and_largest_id)
{
	std::vector<uint8_t> id(16, 0);

	zassert_str_equal(encode_id(id).c_str(), "0000000000000000000000");
	id[15] = 1;
	zassert_str_equal(encode_id(id).c_str(), "0000000000000000000001");
	id.assign(16, 0xff);
	zassert_str_equal(encode_id(id).c_str(), "7N42dgm5tFLK9N8MT7fHC7");
}

/* The alphabet runs from the digits over the lower-case to the upper-case letters. */
ZTEST(zspot_base62, test_ids)
{
	const std::vector<uint8_t> count = {0x00, 0x01, 0x02, 0x03, 0x04, 0x05, 0x06, 0x07,
					    0x08, 0x09, 0x0a, 0x0b, 0x0c, 0x0d, 0x0e, 0x0f};
	const std::vector<uint8_t> mixed = {0x5b, 0x6d, 0x0a, 0x3f, 0x9c, 0x2e, 0x4d, 0x17,
					    0xa8, 0xb0, 0xc4, 0xe1, 0xf2, 0x93, 0x74, 0x65};
	/* What the library reads spotify:track:4uLU6hMCjMI75M1A2tKUQC as */
	const std::vector<uint8_t> track = {0x93, 0xbc, 0x41, 0x4a, 0x60, 0x67, 0x47, 0xb2,
					    0xb6, 0x12, 0x49, 0x1e, 0xf8, 0x3d, 0x5a, 0x3e};

	zassert_str_equal(encode_id(count).c_str(), "000syw7rIjXKeGogUSqgWP");
	zassert_str_equal(encode_id(mixed).c_str(), "2Mw8fYX4YKmcMOc8sumlKZ");
	zassert_str_equal(encode_id(track).c_str(), "4uLU6hMCjMI75M1A2tKUQC");
}

ZTEST(zspot_base62, test_other_lengths)
{
	std::vector<uint8_t> longer(40, 0);

	zassert_str_equal(base62Encode({0x01, 0x00}, 4).c_str(), "0048");
	/* 3839 is "ZV" in two digits, which is all that is asked for */
	zassert_str_equal(base62Encode({0x0e, 0xff}, 2).c_str(), "ZV");
	/* More bytes than an id has */
	longer[39] = 62;
	zassert_str_equal(base62Encode(longer, 3).c_str(), "010");
	zassert_str_equal(base62Encode({}, 2).c_str(), "00");
	zassert_str_equal(base62Encode({0x01}, 0).c_str(), "");
}

ZTEST_SUITE(zspot_base62, NULL, NULL, NULL, NULL, NULL);
```
